## drivers/jet/Kconfig
```kconfig
menuconfig JET_DRIVERS
	bool "Jet Drivers"
        default y
	---help---
	  This is a configuration for JET drivers.

if JET_DRIVERS

source "drivers/jet/btgpio/Kconfig"
source "drivers/jet/cmm/Kconfig"
source "drivers/jet/dpram/Kconfig"
source "drivers/jet/g2d/Kconfig"
source "drivers/jet/g3d/Kconfig"
source "drivers/jet/jpeg/Kconfig"
source "drivers/jet/mfc/Kconfig"
source "drivers/jet/multipdp/Kconfig"
source "drivers/jet/pp/Kconfig"
source "drivers/jet/vibetonz/Kconfig"
source "drivers/jet/wlan/Kconfig"
source "drivers/jet/fimc/Kconfig"
source "drivers/jet/scaler/Kconfig"
source "drivers/jet/tvout/Kconfig"

comment "Reserved memory configurations"

config SAMSUNG_MEMSIZE_FIMC
	int "Memory size in kbytes for FIMC"
	depends on VIDEO_FIMC
	default "5120"

config SAMSUNG_MEMSIZE_POST
	int "Memory size in kbytes for Post Processor"
	depends on VIDEO_POST
	default "8192"

config SAMSUNG_MEMSIZE_TV
	int "Memory size in kbytes for TV"
	depends on VIDEO_TV
	default "8192"

if CPU_S3C6410
config SAMSUNG_MEMSIZE_MFC
	int "Memory size in kbytes for MFC"
	depends on VIDEO_MFC40
	default "32768"

config SAMSUNG_MEMSIZE_JPEG
	int "Memory size in kbytes for JPEG"
	depends on VIDEO_JPEG_V2 
	default "32768"
endif

#config SAMSUNG_MEMSIZE_FIMC
#	int "Memory size in kbytes for FIMC"
#	depends on VIDEO_FIMC
#	default "10240"

#config SAMSUNG_MEMSIZE_PP
#	int "Memory size in kbytes for Post Processor"
#	depends on POST
#	default "8192"

#config SAMSUNG_MEMSIZE_TV
#	int "Memory size in kbytes for TV"
#	depends on TV
#	default "8192"

#if CPU_S3C6410
#config SAMSUNG_MEMSIZE_MFC
#	int "Memory size in kbytes for MFC"
#	depends on MFC
#	default "6144"

#config SAMSUNG_MEMSIZE_JPEG
#	int "Memory size in kbytes for JPEG"
#	depends on JPEG 
#	default "4096"
#endif

endif # JET_DRIVERS
```

## drivers/jet/btgpio/Kconfig
```kconfig
#
# Configuration for BT_GPIO 
#

config BT_GPIO
	bool "Samsung BT_GPIO Driver" 
	default y
	---help---
	  This is a BT_GPIO driver for Samsung S3C6410.
```

## drivers/jet/cmm/Kconfig
```kconfig
#
## CMM configuration
##
#
##menu "S3C_CMM Support"

config S3C_CMM
    bool "Samsung Codec Memory Manager"
    depends on CPU_S3C6410
    default y
	help
	    S3C_CMM
#endmenu
```

## drivers/jet/g2d/Kconfig
```kconfig
#
## G2D subsystem configuration
##
#
##menu "G2D Support"

config VIDEO_G2D
    bool "Samsung FIMG-2D Driver"
    depends on CPU_S3C6410
    default y
	help
	    FIMG-2D
#endmenu
```

## drivers/jet/multipdp/Kconfig
```kconfig
#
# Configuration for MULTIPDP 
#

config MULTIPDP
	bool "Samsung MULTIPDP Driver" 
	default y
	---help---
	  This is a MULTIPDP driver for Samsung S3C6410.
```

## drivers/jet/post/Kconfig
```kconfig
#
# Configuration for Post Porcessor
#

config POST
	bool "Samsung Post Processor Driver" 
	default n
	---help---
	  This is a post processor driver for Samsung S3C6410 and S5P6440.
```

## drivers/jet/scaler/Kconfig
```kconfig
#
# Makefile for JPEG CODEC device driver designed by Samsung Electronics 2007
# Woosung Chung <woosung2.jung@samsung.com>
#

config VIDEO_SCALER
	bool 	  "SAMSUNG SCALER device support"
	depends on CPU_S3C6410
        default y
	help
	    SCALER
```

## drivers/jet/tsi/Kconfig
```kconfig
#
## TSI configuration
##
#

config VIDEO_TSI
	bool "SAMSUNG TSI Driver" 
        depends on CPU_S3C6410
	default y
	help
	   S3C_TSI

config VIDEO_TSI_DEBUG
	bool "print TSI debug message"
	depends on VIDEO_TSI
	default y

config VIDEO_LIST_DEBUG
	bool "print TSI list debug message"
	depends on VIDEO_TSI
	default y
```

## drivers/jet/tvout/Kconfig
```kconfig
#
# Makefile for TVout device driver designed by Samsung Electronics 2007
#
##menu "VIDEO TVOUT"

config VIDEO_TVOUT
        bool "SAMSUNG TV-out device support"
        depends on CPU_S3C6410
        default y
	help
	    TVOUT
#endmenu
```

## drivers/jet/vibetonz/Kconfig
```kconfig
#
# Configuration for Vibrator
#

config VIBETONZ
	bool "Samsung Vibrator Driver" 
	default y
	---help---
	  This is a Vibrator driver for Samsung S3C6410.
```

## drivers/jetmodules/Kconfig
```kconfig
menuconfig JET_MODULES
	bool "JetDroid Modules"
	default y
	---help---
	  This are various modules for the s3c6410 processor.

if JET_MODULES

source "drivers/jetmodules/post/Kconfig"
source "drivers/jetmodules/mfc/Kconfig"
source "drivers/jetmodules/jpeg/Kconfig"
source "drivers/jetmodules/rotator/Kconfig"
source "drivers/jetmodules/g2d/Kconfig"
source "drivers/jetmodules/g3d/Kconfig"
source "drivers/jetmodules/cmm/Kconfig"
source "drivers/jetmodules/xsr/Kconfig"
source "drivers/jetmodules/rfs/Kconfig"
source "drivers/jetmodules/dpram/Kconfig"
source "drivers/jetmodules/vibetonz/Kconfig"
source "drivers/jetmodules/btgpio/Kconfig"
source "drivers/jetmodules/multipdp/Kconfig"
source "drivers/jetmodules/param/Kconfig"
#source "drivers/jetmodules/camera/Kconfig"

comment "Reserved memory configurations"

config VIDEO_SAMSUNG_MEMSIZE_FIMC
	int "Memory size in kbytes for FIMC"
	depends on VIDEO_FIMC
	default "10240"

config SAMSUNG_MEMSIZE_POST
	int "Memory size in kbytes for Post Processor"
	depends on POST
	default "8192"

config SAMSUNG_MEMSIZE_TV
	int "Memory size in kbytes for TV"
	depends on TV
	default "8192"

if CPU_S3C6410
config SAMSUNG_MEMSIZE_MFC
	int "Memory size in kbytes for MFC"
	depends on MFC
	default "6144"

config SAMSUNG_MEMSIZE_JPEG
	int "Memory size in kbytes for JPEG"
	depends on JPEG 
	default "4096"
endif

endif # JET_MODULES
```

## drivers/jetmodules/btgpio/Kconfig
```kconfig
#
# Configuration for BT_GPIO 
#

config BT_GPIO
	bool "Samsung BT_GPIO Driver" 
	default n
	---help---
	  This is a BT_GPIO driver for Samsung S3C6410.
```

## drivers/jetmodules/cmm/Kconfig
```kconfig
#
# Configuration for CMM 
#

config CMM
	bool "Samsung CMM Driver" 
	default n
	---help---
	  This is a CMM driver for Samsung S3C6410.
```

## drivers/jetmodules/dpram/Kconfig
```kconfig
#
# Configuration for Dpram
#

config DPRAM
	bool "Samsung Dpram Driver" 
	default n
	---help---
	  This is a Dpram driver for Samsung S3C6410 and S5P6440.
```

## drivers/jetmodules/g2d/Kconfig
```kconfig
#
# Configuration for G-2D
#

config G2D
	bool "Samsung G-2D Driver" 
	default n
	---help---
	  This is a G-2D(2D accelerator) driver for Samsung S3C6410 and S5PC100.
```

## drivers/jetmodules/g3d/Kconfig
```kconfig
#
# Configuration for G-3D
#

config G3D
	bool "Samsung G-3D Driver" 
	default n
	---help---
	  This is a G-3D(3D accelerator) driver for Samsung S3C6410 and S5PC100.
```

## drivers/jetmodules/jpeg/Kconfig
```kconfig
#
# Configuration for G-3D
#

config JPEG
	bool "Samsung JPEG Driver" 
	default n
	---help---
	  This is a JPEG driver for Samsung S3C6410 and S5PC100.
```

## drivers/jetmodules/mfc/Kconfig
```kconfig
#
# Configuration for Multi Format Codecs (MFC)
#

config MFC
	bool "Samsung FIMV V1.0 - MFC (Multi Format Codec) Driver" 
	default n
	---help---
	  This is a Multi Format Codecs (MFC) driver for Samsung S3C6400 and s3C6410.

config MFC_DEBUG
	bool "print MFC debug message"
	depends on MFC
	default n
```

## drivers/jetmodules/multipdp/Kconfig
```kconfig
#
# Configuration for MULTIPDP 
#

config MULTIPDP
	bool "Samsung MULTIPDP Driver" 
	default m
	---help---
	  This is a MULTIPDP driver for Samsung S3C6410.
```

## drivers/jetmodules/param/Kconfig
```kconfig
#
# Configuration for PARAM 
#

config PARAM
	bool "Samsung PARAM Driver" 
	default n
	---help---
	  This is a PARAM driver for Samsung S3C6410.
```

## drivers/jetmodules/vibetonz/Kconfig
```kconfig
#
# Configuration for Vibrator
#

config VIBETONZ
	bool "Samsung Vibrator Driver" 
	default n
	---help---
	  This is a Vibrator driver for Samsung S3C6410.
```

## drivers/media/video/samsung/rotator/Kconfig
```kconfig
#
# Configuration for rotator
#

config ROTATOR
	bool "Samsung Image Rotator Driver" 
	default n
	---help---
	  This is a Rotator for Samsung S3C6410 and S5PC100.
```
